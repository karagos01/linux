## Documentation/devicetree/bindings/regulator/willsemi,wl28681.yaml
```yaml
# SPDX-License-Identifier: (GPL-2.0-only OR BSD-2-Clause)
%YAML 1.2
---
$id: http://devicetree.org/schemas/regulator/willsemi,wl28681.yaml#
$schema: http://devicetree.org/meta-schemas/core.yaml#

title: Will Semiconductor WL28681 camera PMIC

maintainers:
  - Jan Benedikt <karagos01@gmail.com>

description:
  The WL28681 is an I2C controlled power management IC for camera modules
  with seven low-dropout regulators, programmable in 8 mV steps. LDO1 and
  LDO2 are low-voltage outputs for digital cores (for example 1.2 V), LDO3
  to LDO7 high-voltage outputs for analog, I/O and actuator supplies (for
  example 1.8 V and 2.8 V).

properties:
  compatible:
    const: willsemi,wl28681

  reg:
    maxItems: 1

  enable-gpios:
    maxItems: 1
    description:
      GPIO connected to the chip enable (reset) pin, active high. The chip
      does not answer on I2C while it is held low.

  vin12-supply:
    description: Input supply of LDO1 and LDO2.

  regulators:
    type: object
    additionalProperties: false

    patternProperties:
      "^ldo[1-7]$":
        type: object
        $ref: regulator.yaml#
        unevaluatedProperties: false

required:
  - compatible
  - reg
  - regulators

additionalProperties: false

examples:
  - |
    #include <dt-bindings/gpio/gpio.h>

    i2c {
        #address-cells = <1>;
        #size-cells = <0>;

        pmic@35 {
            compatible = "willsemi,wl28681";
            reg = <0x35>;
            enable-gpios = <&pio 183 GPIO_ACTIVE_HIGH>;

            regulators {
                ldo2 {
                    regulator-name = "cam2-dvdd";
                    regulator-min-microvolt = <1200000>;
                    regulator-max-microvolt = <1200000>;
                };

                ldo6 {
                    regulator-name = "cam-dovdd";
                    regulator-min-microvolt = <1800000>;
                    regulator-max-microvolt = <1808000>;
                };
            };
        };
    };
```

## Documentation/devicetree/bindings/soc/mediatek/mediatek,mt6878-apu-top.yaml
```yaml
# SPDX-License-Identifier: (GPL-2.0-only OR BSD-2-Clause)
%YAML 1.2
---
$id: http://devicetree.org/schemas/soc/mediatek/mediatek,mt6878-apu-top.yaml#
$schema: http://devicetree.org/meta-schemas/core.yaml#

title: MediaTek MT6878 APU power controller

maintainers:
  - Jan Benedikt <karagos01@gmail.com>

description:
  The remote power controller (RPC) of the AI processing unit. It powers the
  APU up on request; only the APU firmware can send it back to sleep.

properties:
  compatible:
    const: mediatek,mt6878-apu-top

  reg:
    maxItems: 1

  '#power-domain-cells':
    const: 0

required:
  - compatible
  - reg
  - '#power-domain-cells'

additionalProperties: false

examples:
  - |
    power-controller@190f0000 {
        compatible = "mediatek,mt6878-apu-top";
        reg = <0x190f0000 0x1000>;
        #power-domain-cells = <0>;
    };
```

## Documentation/devicetree/bindings/soc/mediatek/mediatek,mt6878-apu.yaml
```yaml
# SPDX-License-Identifier: (GPL-2.0-only OR BSD-2-Clause)
%YAML 1.2
---
$id: http://devicetree.org/schemas/soc/mediatek/mediatek,mt6878-apu.yaml#
$schema: http://devicetree.org/meta-schemas/core.yaml#

title: MediaTek MT6878 APU firmware host interface

maintainers:
  - Jan Benedikt <karagos01@gmail.com>

description:
  The mailbox through which the host talks to the firmware of the AI
  processing unit. The firmware image is placed in secure memory by the
  bootloader and started through the secure monitor; everything the host
  shares with it is addressed through the APU IOMMU.

properties:
  compatible:
    const: mediatek,mt6878-apu

  reg:
    maxItems: 1

  interrupts:
    maxItems: 1

  iommus:
    maxItems: 1

  power-domains:
    maxItems: 1

required:
  - compatible
  - reg
  - interrupts
  - iommus
  - power-domains

additionalProperties: false

examples:
  - |
    #include <dt-bindings/interrupt-controller/arm-gic.h>

    remoteproc@190e1000 {
        compatible = "mediatek,mt6878-apu";
        reg = <0x190e1000 0x1000>;
        interrupts = <GIC_SPI 586 IRQ_TYPE_LEVEL_HIGH 0>;
        iommus = <&apu_iommu 0>;
        power-domains = <&apu_top>;
    };
```

## drivers/media/platform/mediatek/isp/Kconfig
```kconfig
# SPDX-License-Identifier: GPL-2.0-only

config VIDEO_MTK_ISP7X_SENINF
	tristate "MediaTek ISP7.x seninf CSI-2 receiver"
	depends on ARCH_MEDIATEK || COMPILE_TEST
	depends on VIDEO_DEV
	select MEDIA_CONTROLLER
	select VIDEO_V4L2_SUBDEV_API
	select V4L2_FWNODE
	help
	  Support for the seninf sensor interface of MediaTek ISP7.x camera
	  systems, such as the one in MT6878. Seninf receives MIPI CSI-2
	  data from the camera sensors and routes it to the capture units.

	  To compile this driver as a module, choose M here: the module
	  will be called mtk-seninf.
```
