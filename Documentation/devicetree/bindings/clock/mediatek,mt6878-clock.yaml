## Documentation/devicetree/bindings/ufs/mediatek,ufs.yaml
```yaml
# SPDX-License-Identifier: GPL-2.0-only OR BSD-2-Clause
%YAML 1.2
---
$id: http://devicetree.org/schemas/ufs/mediatek,ufs.yaml#
$schema: http://devicetree.org/meta-schemas/core.yaml#

title: Mediatek Universal Flash Storage (UFS) Controller

maintainers:
  - Peter Wang <peter.wang@mediatek.com>
  - Chaotian Jing <chaotian.jing@mediatek.com>

properties:
  compatible:
    enum:
      - mediatek,mt6878-ufshci
      - mediatek,mt8183-ufshci
      - mediatek,mt8192-ufshci
      - mediatek,mt8195-ufshci

  clocks:
    minItems: 1
    maxItems: 13

  clock-names:
    minItems: 1
    maxItems: 13

  phys:
    maxItems: 1

  reg:
    maxItems: 1

  resets:
    minItems: 1
    maxItems: 4

  reset-names:
    minItems: 1
    items:
      - const: unipro_rst
      - const: crypto_rst
      - const: hci_rst
      - const: mphy_rst

  vcc-supply: true

  mediatek,ufs-disable-mcq:
    $ref: /schemas/types.yaml#/definitions/flag
    description: The mask to disable MCQ (Multi-Circular Queue) for UFS host.

required:
  - compatible
  - clocks
  - clock-names
  - phys
  - reg

unevaluatedProperties: false

allOf:
  - $ref: ufs-common.yaml

  - if:
      properties:
        compatible:
          contains:
            enum:
              - mediatek,mt8195-ufshci
    then:
      properties:
        clocks:
          minItems: 8
        clock-names:
          items:
            - const: ufs
            - const: ufs_aes
            - const: ufs_tick
            - const: unipro_sysclk
            - const: unipro_tick
            - const: unipro_mp_bclk
            - const: ufs_tx_symbol
            - const: ufs_mem_sub

  - if:
      properties:
        compatible:
          contains:
            enum:
              - mediatek,mt6878-ufshci
    then:
      properties:
        clocks:
          minItems: 13
        clock-names:
          items:
            - const: ufs_sel
            - const: ufs_fde
            - const: ufs_mbist
            - const: unipro_tx_sym
            - const: unipro_rx_sym0
            - const: unipro_rx_sym1
            - const: unipro_sys
            - const: unipro_phy_sap
            - const: phy_top_ahb_s_bus
            - const: ufshci_ufs
            - const: ufshci_aes
            - const: ufshci_ufs_ahb
            - const: ufshci_aes_axi
        resets:
          minItems: 3
        reset-names:
          minItems: 3

  - if:
      properties:
        compatible:
          contains:
            enum:
              - mediatek,mt8183-ufshci
              - mediatek,mt8192-ufshci
    then:
      properties:
        clocks:
          maxItems: 1
        clock-names:
          items:
            - const: ufs

  # The MT6878 powers its UFS rails outside this node (always-on / handled by
  # the bootloader), so vcc-supply is optional there. Every other SoC must
  # provide it.
  - if:
      not:
        properties:
          compatible:
            contains:
              const: mediatek,mt6878-ufshci
    then:
      required:
        - vcc-supply

examples:
  - |
    #include <dt-bindings/clock/mt8183-clk.h>
    #include <dt-bindings/interrupt-controller/arm-gic.h>

    soc {
        #address-cells = <2>;
        #size-cells = <2>;

        ufs@ff3c0000 {
            compatible = "mediatek,mt8183-ufshci";
            reg = <0 0x11270000 0 0x2300>;
            interrupts = <GIC_SPI 104 IRQ_TYPE_LEVEL_LOW>;
            phys = <&ufsphy>;

            clocks = <&infracfg_ao CLK_INFRA_UFS>;
            clock-names = "ufs";
            freq-table-hz = <0 0>;

            vcc-supply = <&mt_pmic_vemc_ldo_reg>;
        };
    };
```

## Documentation/devicetree/bindings/usb/mediatek,mt6375-tcpc.yaml
```yaml
# SPDX-License-Identifier: (GPL-2.0-only OR BSD-2-Clause)
%YAML 1.2
---
$id: http://devicetree.org/schemas/usb/mediatek,mt6375-tcpc.yaml#
$schema: http://devicetree.org/meta-schemas/core.yaml#

title: MediaTek MT6375 Type-C Port Switch and Power Delivery controller

maintainers:
  - Jan Benedikt <karagos01@gmail.com>

description: |
  The MT6375 SubPMIC integrates a TCPCI-compliant USB Type-C Port Controller
  with a Power Delivery physical layer. It performs Type-C attach and
  orientation detection and the BMC PD signalling. This document describes
  only the Type-C Port Switch and Power Delivery controller; it is one
  function of the MT6375 MFD device (see mfd/mediatek,mt6375.yaml).

properties:
  compatible:
    enum:
      - mediatek,mt6375-tcpc

  interrupts:
    maxItems: 1

  connector:
    type: object
    $ref: /schemas/connector/usb-connector.yaml#
    unevaluatedProperties: false

additionalProperties: false

required:
  - compatible
  - interrupts
  - connector

...
```

## drivers/net/wireless/mediatek/mt76/mt7921/Kconfig
```kconfig
# SPDX-License-Identifier: BSD-3-Clause-Clear
config MT7921_COMMON
	tristate
	select MT792x_LIB
	select WANT_DEV_COREDUMP

config MT7921E
	tristate "MediaTek MT7921E (PCIe) support"
	select MT7921_COMMON
	depends on MAC80211
	depends on PCI
	help
	  This adds support for MT7921E 802.11ax 2x2:2SS wireless devices.

	  To compile this driver as a module, choose M here.

config MT7921_SOC
	tristate "MediaTek MT7921 compatible SoC integrated WiFi support"
	select MT7921_COMMON
	depends on MAC80211
	depends on MTK_CONNSYS
	help
	  This adds support for the 802.11ax 2x2:2SS WiFi integrated in the
	  connectivity subsystem of MediaTek SoCs like the MT6878.

	  To compile this driver as a module, choose M here.

config MT7921S
	tristate "MediaTek MT7921S (SDIO) support"
	select MT76_SDIO
	select MT7921_COMMON
	depends on MAC80211
	depends on MMC
	help
	  This adds support for MT7921S 802.11ax 2x2:2SS wireless devices.

	  To compile this driver as a module, choose M here.

config MT7921U
	tristate "MediaTek MT7921U (USB) support"
	select MT792x_USB
	select MT7921_COMMON
	depends on MAC80211
	depends on USB
	help
	  This adds support for MT7921U 802.11ax 2x2:2SS wireless devices.

	  To compile this driver as a module, choose M here.
```
