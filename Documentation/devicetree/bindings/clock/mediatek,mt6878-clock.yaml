## Documentation/devicetree/bindings/remoteproc/mediatek,mt6878-scp.yaml
```yaml
# SPDX-License-Identifier: (GPL-2.0 OR BSD-2-Clause)
%YAML 1.2
---
$id: http://devicetree.org/schemas/remoteproc/mediatek,mt6878-scp.yaml#
$schema: http://devicetree.org/meta-schemas/core.yaml#

title: MediaTek MT6878 SCP (Andes RV55 tinysys)

maintainers:
  - kara <karagos01@gmail.com>

description:
  The System Companion Processor on the MediaTek MT6878 is an Andes RV55
  (RISC-V) core running an MTK tinysys firmware container. Unlike the ARM
  Cortex-M SCPs described by mtk,scp.yaml, its firmware is staged into
  reserved DRAM by the bootloader and the core is released through the
  resident TF-A via an SiP SMC, so the binding describes no clocks. It acts
  as a sensor hub, exchanging packets with the host over a set of hardware
  mailboxes.

properties:
  compatible:
    const: mediatek,mt6878-scp

  reg:
    items:
      - description: SRAM / TCM, where the firmware is executed from
      - description: SCP configuration registers
      - description: core 0 configuration registers
      - description: core 1 configuration registers
      - description: mailbox 0 registers
      - description: mailbox 1 registers
      - description: mailbox 2 registers
      - description: mailbox 3 registers
      - description: mailbox 4 registers

  reg-names:
    items:
      - const: sram
      - const: cfg
      - const: cfg_core0
      - const: cfg_core1
      - const: mbox0
      - const: mbox1
      - const: mbox2
      - const: mbox3
      - const: mbox4

  interrupts:
    items:
      - description: IPC interrupt 0
      - description: IPC interrupt 1
      - description: mailbox 0 interrupt
      - description: mailbox 1 interrupt
      - description: mailbox 2 interrupt
      - description: mailbox 3 interrupt
      - description: mailbox 4 interrupt

  interrupt-names:
    items:
      - const: ipc0
      - const: ipc1
      - const: mbox0
      - const: mbox1
      - const: mbox2
      - const: mbox3
      - const: mbox4

  mediatek,infracfg:
    $ref: /schemas/types.yaml#/definitions/phandle
    description:
      Phandle to the infracfg-ao syscon that holds the SCP "awake" doorbell
      registers. The host rings this doorbell to wake the SCP out of deep
      idle before sending it mailbox traffic, so a sleeping SCP keeps acking
      commands. If absent, the awake handshake is disabled.

required:
  - compatible
  - reg
  - reg-names
  - interrupts
  - interrupt-names

additionalProperties: false

examples:
  - |
    #include <dt-bindings/interrupt-controller/arm-gic.h>
    #include <dt-bindings/interrupt-controller/irq.h>

    scp@1c400000 {
        compatible = "mediatek,mt6878-scp";
        reg = <0x1c400000 0x100000>,
              <0x1cb24000 0x1000>,
              <0x1cb30000 0x1000>,
              <0x1cb40000 0x1000>,
              <0x1cba0000 0x1000>,
              <0x1cbb0000 0x1000>,
              <0x1cbc0000 0x1000>,
              <0x1cbd0000 0x1000>,
              <0x1cbe0000 0x1000>;
        reg-names = "sram", "cfg", "cfg_core0", "cfg_core1",
                    "mbox0", "mbox1", "mbox2", "mbox3", "mbox4";
        interrupts = <GIC_SPI 516 IRQ_TYPE_LEVEL_HIGH 0>,
                     <GIC_SPI 517 IRQ_TYPE_LEVEL_HIGH 0>,
                     <GIC_SPI 518 IRQ_TYPE_LEVEL_HIGH 0>,
                     <GIC_SPI 519 IRQ_TYPE_LEVEL_HIGH 0>,
                     <GIC_SPI 520 IRQ_TYPE_LEVEL_HIGH 0>,
                     <GIC_SPI 521 IRQ_TYPE_LEVEL_HIGH 0>,
                     <GIC_SPI 522 IRQ_TYPE_LEVEL_HIGH 0>;
        interrupt-names = "ipc0", "ipc1", "mbox0", "mbox1",
                          "mbox2", "mbox3", "mbox4";
        mediatek,infracfg = <&infracfg_ao>;
    };
```

## Documentation/devicetree/bindings/soc/mediatek/mediatek,mt6878-ccci.yaml
```yaml
# SPDX-License-Identifier: GPL-2.0-only OR BSD-2-Clause
%YAML 1.2
---
$id: http://devicetree.org/schemas/soc/mediatek/mediatek,mt6878-ccci.yaml#
$schema: http://devicetree.org/meta-schemas/core.yaml#

title: MediaTek MT6878 modem (CCCI)

maintainers:
  - Jan Benedikt <karagos01@gmail.com>

description:
  The MT6878 integrates a cellular modem reached from the application
  processor over the "CCCI" cross-core communication interface. The modem
  firmware is loaded by the bootloader; this node boots the modem and exposes
  its control channels and the DPMAIF data path. Control and data run through
  shared-memory regions handed over from the bootloader, and a pair of CCIF
  mailboxes plus a DPMAIF interrupt drive the two cores.

properties:
  compatible:
    const: mediatek,mt6878-ccci

  reg:
    items:
      - description: AP-side CCIF mailbox
      - description: MD-side CCIF mailbox
      - description: infracfg
      - description: SPM (system power manager)
      - description: topckgen
      - description: infracfg-ao (always-on)
      - description: NEMI configuration
      - description: DPMAIF always-on
      - description: DPMAIF power domain

  reg-names:
    items:
      - const: ap-ccif
      - const: md-ccif
      - const: infracfg
      - const: spm
      - const: topckgen
      - const: infracfg-ao
      - const: nemicfg
      - const: dpmaif-ao
      - const: dpmaif-pd

  interrupts:
    items:
      - description: CCIF mailbox interrupt
      - description: CCIF exception interrupt
      - description: DPMAIF data-path interrupt

  memory-region:
    items:
      - description: Bootloader handover tag region
      - description: Modem non-cacheable shared memory
      - description: Modem cacheable shared memory

required:
  - compatible
  - reg
  - reg-names
  - interrupts
  - memory-region

additionalProperties: false

examples:
  - |
    #include <dt-bindings/interrupt-controller/arm-gic.h>
    #include <dt-bindings/interrupt-controller/irq.h>

    modem@10209000 {
        compatible = "mediatek,mt6878-ccci";
        reg = <0x10209000 0x1000>,
              <0x1020a000 0x1000>,
              <0x1020e000 0x1000>,
              <0x1c001000 0x1000>,
              <0x10000000 0x1000>,
              <0x10001000 0x1000>,
              <0x10270000 0x1000>,
              <0x10014000 0x1000>,
              <0x1022d000 0x1000>;
        reg-names = "ap-ccif", "md-ccif", "infracfg", "spm", "topckgen",
                    "infracfg-ao", "nemicfg", "dpmaif-ao", "dpmaif-pd";
        interrupts = <GIC_SPI 228 IRQ_TYPE_LEVEL_HIGH 0>,
                     <GIC_SPI 229 IRQ_TYPE_LEVEL_HIGH 0>,
                     <GIC_SPI 238 IRQ_TYPE_LEVEL_HIGH 0>;
        memory-region = <&ccci_tag>, <&md_nc_smem>, <&md_c_smem>;
    };
```

## Documentation/devicetree/bindings/soc/mediatek/mediatek,mt6878-connsys.yaml
```yaml
# SPDX-License-Identifier: GPL-2.0-only OR BSD-2-Clause
%YAML 1.2
---
$id: http://devicetree.org/schemas/soc/mediatek/mediatek,mt6878-connsys.yaml#
$schema: http://devicetree.org/meta-schemas/core.yaml#

title: MediaTek MT6878 connsys combo controller

maintainers:
  - Jan Benedikt <karagos01@gmail.com>

description:
  The "connsys" combo in the MT6878 hosts WiFi, Bluetooth, GPS and FM behind a
  shared power domain, a shared A-die and a set of analog supplies. This node
  owns those shared resources; the per-function controllers (WiFi, Bluetooth)
  reference it through a "mediatek,connsys" phandle and are brought up on top of
  it. The firmware is staged into the reserved connsys EMI region by the
  bootloader.

properties:
  compatible:
    const: mediatek,mt6878-connsys

  reg:
    items:
      - description: conn_infra register window
      - description: srclken-rc (source-clock enable) register window

  reg-names:
    items:
      - const: conn
      - const: srclken-rc

  memory-region:
    maxItems: 1
    description: Reserved EMI region the bootloader stages the firmware into.

  power-domains:
    maxItems: 1

  mediatek,topckgen:
    $ref: /schemas/types.yaml#/definitions/phandle
    description: Phandle to the topckgen syscon, used to route the bus clocks.

  mediatek,xtal-52mhz:
    type: boolean
    description:
      Present when the A-die reference crystal runs at 52 MHz instead of the
      default 26 MHz.

  pinctrl-names:
    items:
      - const: default
      - const: sleep
      - const: adie-cfg

  pinctrl-0: true
  pinctrl-1: true
  pinctrl-2: true

  vrfio18-supply:
    description: RF I/O 1.8 V supply.

  vcn13-supply:
    description: A-die 1.3 V supply.

  vcn33-1-supply:
    description: A-die 3.3 V supply, rail 1.

  vcn33-2-supply:
    description: A-die 3.3 V supply, rail 2.

  vant18-supply:
    description: Antenna 1.8 V supply.

required:
  - compatible
  - reg
  - reg-names
  - memory-region
  - power-domains
  - mediatek,topckgen
  - vrfio18-supply
  - vcn13-supply
  - vcn33-1-supply
  - vcn33-2-supply
  - vant18-supply

additionalProperties: false

examples:
  - |
    #include <dt-bindings/power/mediatek,mt6878-power.h>

    connsys@18000000 {
        compatible = "mediatek,mt6878-connsys";
        reg = <0x18000000 0x80000>,
              <0x1c00d000 0x1000>;
        reg-names = "conn", "srclken-rc";
        memory-region = <&consys_emi>;
        power-domains = <&spm MT6878_POWER_DOMAIN_CONN>;
        mediatek,topckgen = <&topckgen>;
        pinctrl-names = "default", "sleep", "adie-cfg";
        pinctrl-0 = <&conn_pins_default>;
        pinctrl-1 = <&conn_pins_sleep>;
        pinctrl-2 = <&conn_pins_adie_cfg>;
        vrfio18-supply = <&mt6363_vrfio18>;
        vcn13-supply = <&mt6363_vcn13>;
        vcn33-1-supply = <&mt6369_vcn33_1>;
        vcn33-2-supply = <&mt6369_vcn33_2>;
        vant18-supply = <&mt6369_vant18>;
    };
```

## Documentation/devicetree/bindings/soc/mediatek/mediatek,mt6878-disp-refresh.yaml
```yaml
# SPDX-License-Identifier: GPL-2.0-only OR BSD-2-Clause
%YAML 1.2
---
$id: http://devicetree.org/schemas/soc/mediatek/mediatek,mt6878-disp-refresh.yaml#
$schema: http://devicetree.org/meta-schemas/core.yaml#

title: MediaTek MT6878 bootloader command-mode panel refresher

maintainers:
  - Jan Benedikt <karagos01@gmail.com>

description:
  The bootloader leaves the display pipeline (OVL0 -> ... -> DSI0) scanning out
  a framebuffer to a command-mode panel. This device keeps pushing frames to
  that panel through the display mutex and DSI engine the bootloader set up,
  without a full display driver, and exposes the panel brightness (DCS 0x51)
  as a backlight device.

properties:
  compatible:
    const: mediatek,mt6878-disp-refresh

  reg:
    items:
      - description: display mutex register window
      - description: DSI engine register window

  reg-names:
    items:
      - const: mutex
      - const: dsi

  mediatek,mutex-id:
    $ref: /schemas/types.yaml#/definitions/uint32
    description: Index of the display mutex the bootloader programmed.

required:
  - compatible
  - reg
  - reg-names
  - mediatek,mutex-id

additionalProperties: false

examples:
  - |
    display-refresh@14001000 {
        compatible = "mediatek,mt6878-disp-refresh";
        reg = <0x14001000 0x1000>,
              <0x1401a000 0x1000>;
        reg-names = "mutex", "dsi";
        mediatek,mutex-id = <0>;
    };
```

## Documentation/devicetree/bindings/soc/mediatek/mediatek,mt6878-gps.yaml
```yaml
# SPDX-License-Identifier: GPL-2.0-only OR BSD-2-Clause
%YAML 1.2
---
$id: http://devicetree.org/schemas/soc/mediatek/mediatek,mt6878-gps.yaml#
$schema: http://devicetree.org/meta-schemas/core.yaml#

title: MediaTek MT6878 connsys GNSS (GPS) subsystem

maintainers:
  - Kara <karagos01@gmail.com>

description:
  The GNSS (GPS) function of the MT6878 connsys combo. It sits on top of the
  shared conn_infra and A-die owned by the connsys controller, which it
  references through a "mediatek,connsys" phandle. The node exposes the GPS
  register window and the conn_infra control window, plus the host-side
  interrupts of the two GPS links (data, no-data and MCU-mailbox each) and the
  DMA engine.

properties:
  compatible:
    const: mediatek,mt6878-gps

  reg:
    items:
      - description: GPS (conn_gps) register window
      - description: shared conn_infra register window

  reg-names:
    items:
      - const: conn_gps
      - const: conn_infra

  interrupts:
    items:
      - description: link0 data
      - description: link0 no-data
      - description: link0 MCU-mailbox (MCUB)
      - description: link1 data
      - description: link1 no-data
      - description: link1 MCU-mailbox (MCUB)
      - description: DMA

  mediatek,connsys:
    $ref: /schemas/types.yaml#/definitions/phandle
    description:
      Phandle to the connsys controller that owns the shared conn_infra, the
      A-die and the connsys power domain.

  pinctrl-names:
    const: default

  pinctrl-0:
    description:
      The external GPS L1/L5 eLNA enable GPIOs, driven high while the GPS
      device is bound.

required:
  - compatible
  - reg
  - reg-names
  - interrupts
  - mediatek,connsys

additionalProperties: false

examples:
  - |
    #include <dt-bindings/interrupt-controller/arm-gic.h>

    soc {
        #address-cells = <2>;
        #size-cells = <2>;

        gps@18c00000 {
            compatible = "mediatek,mt6878-gps";
            reg = <0x0 0x18c00000 0x0 0x100000>,
                  <0x0 0x18000000 0x0 0x100000>;
            reg-names = "conn_gps", "conn_infra";
            interrupts = <GIC_SPI 379 IRQ_TYPE_LEVEL_HIGH 0>,
                         <GIC_SPI 380 IRQ_TYPE_LEVEL_HIGH 0>,
                         <GIC_SPI 381 IRQ_TYPE_LEVEL_HIGH 0>,
                         <GIC_SPI 382 IRQ_TYPE_LEVEL_HIGH 0>,
                         <GIC_SPI 383 IRQ_TYPE_LEVEL_HIGH 0>,
                         <GIC_SPI 389 IRQ_TYPE_LEVEL_HIGH 0>,
                         <GIC_SPI 129 IRQ_TYPE_LEVEL_HIGH 0>;
            mediatek,connsys = <&connsys>;
            pinctrl-names = "default";
            pinctrl-0 = <&gps_elna_pins>;
        };
    };
```
