## Documentation/devicetree/bindings/clock/mediatek,mt6878-clock.yaml
```yaml
# SPDX-License-Identifier: GPL-2.0-only OR BSD-2-Clause
%YAML 1.2
---
$id: http://devicetree.org/schemas/clock/mediatek,mt6878-clock.yaml#
$schema: http://devicetree.org/meta-schemas/core.yaml#

title: MediaTek MT6878 clock controllers

maintainers:
  - Jan Benedikt <karagos01@gmail.com>

description:
  The MT6878 exposes several functional clock controllers as syscon register
  blocks - the top clock generator (topckgen), the PLL controller (apmixedsys)
  and the I2C "IMP" clock wrappers. Each provides clocks through a
  '#clock-cells' of 1.

properties:
  compatible:
    items:
      - enum:
          - mediatek,mt6878-topckgen
          - mediatek,mt6878-apmixedsys
          - mediatek,mt6878-imp_iic_wrap-cs
          - mediatek,mt6878-imp_iic_wrap-es
          - mediatek,mt6878-imp_iic_wrap-ws
          - mediatek,mt6878-imp_iic_wrap-ess
      - const: syscon

  reg:
    maxItems: 1

  '#clock-cells':
    const: 1

  hw-voter-regmap:
    $ref: /schemas/types.yaml#/definitions/phandle
    description:
      Phandle to the hardware-voter syscon used by topckgen to vote for
      clocks shared with other subsystems.

  mediatek,hardware-voter:
    $ref: /schemas/types.yaml#/definitions/phandle
    description:
      Phandle to the hardware-voter syscon used by apmixedsys.

required:
  - compatible
  - reg
  - '#clock-cells'

additionalProperties: false

examples:
  - |
    clock-controller@10000000 {
        compatible = "mediatek,mt6878-topckgen", "syscon";
        reg = <0x10000000 0x1000>;
        #clock-cells = <1>;
        hw-voter-regmap = <&hwv>;
    };

  - |
    clock-controller@11281000 {
        compatible = "mediatek,mt6878-imp_iic_wrap-cs", "syscon";
        reg = <0x11281000 0x1000>;
        #clock-cells = <1>;
    };
```

## Documentation/devicetree/bindings/clock/mediatek,mt6878-ufscfg.yaml
```yaml
# SPDX-License-Identifier: GPL-2.0-only OR BSD-2-Clause
%YAML 1.2
---
$id: http://devicetree.org/schemas/clock/mediatek,mt6878-ufscfg.yaml#
$schema: http://devicetree.org/meta-schemas/core.yaml#

title: MediaTek MT6878 UFS configuration clock and reset controllers

maintainers:
  - Kara <karagos01@gmail.com>

description:
  The MT6878 UFS configuration blocks (always-on and power-down) are syscon
  register regions that provide the UFS clocks and, through a ti,syscon-reset
  child, the UFS resets.

properties:
  compatible:
    items:
      - enum:
          - mediatek,mt6878-ufscfg-ao
          - mediatek,mt6878-ufscfg-pdn
      - const: syscon
      - const: simple-mfd

  reg:
    maxItems: 1

  '#clock-cells':
    const: 1

  reset-controller:
    type: object
    description: UFS reset lines, driven through the syscon (see ti,syscon-reset).

required:
  - compatible
  - reg
  - '#clock-cells'

additionalProperties: false

examples:
  - |
    clock-controller@112b8000 {
        compatible = "mediatek,mt6878-ufscfg-ao", "syscon", "simple-mfd";
        reg = <0x112b8000 0x1000>;
        #clock-cells = <1>;

        reset-controller {
            compatible = "ti,syscon-reset";
            #reset-cells = <1>;
            ti,reset-bits = <0x48 8 0x4c 8 0 0 0>;
        };
    };
```

## Documentation/devicetree/bindings/mfd/mediatek,mt6375.yaml
```yaml
# SPDX-License-Identifier: (GPL-2.0-only OR BSD-2-Clause)
%YAML 1.2
---
$id: http://devicetree.org/schemas/mfd/mediatek,mt6375.yaml#
$schema: http://devicetree.org/meta-schemas/core.yaml#

title: MediaTek MT6375 SubPMIC

maintainers:
  - Jan Benedikt <karagos01@gmail.com>

description:
  MT6375 is a companion power management IC that bundles a single-cell
  Li-Ion/Li-Polymer switching battery charger with BC1.2 detection, an
  auxiliary ADC, a coulomb-counter fuel gauge and a USB Type-C & Power
  Delivery port controller. The die is reached over several I2C slave
  addresses on one bus, presented as a single banked register space.

properties:
  compatible:
    const: mediatek,mt6375

  reg:
    maxItems: 1

  interrupts:
    maxItems: 1

  interrupt-controller: true

  "#interrupt-cells":
    const: 1

  adc:
    type: object
    additionalProperties: false
    description:
      Auxiliary ADC reporting the battery, system and charger input voltages
      and currents, the junction temperature and the USB D+/D- and Type-C
      CC/SBU lines.

    properties:
      compatible:
        const: mediatek,mt6375-adc

      "#io-channel-cells":
        const: 1

    required:
      - compatible
      - "#io-channel-cells"

  charger:
    type: object
    $ref: /schemas/power/supply/mediatek,mt6375-charger.yaml#

  gauge:
    type: object
    $ref: /schemas/power/supply/mediatek,mt6375-gauge.yaml#

required:
  - compatible
  - reg
  - interrupts
  - interrupt-controller
  - "#interrupt-cells"

additionalProperties: false

examples:
  - |
    #include <dt-bindings/interrupt-controller/irq.h>
    #include <dt-bindings/iio/adc/mediatek,mt6375_adc.h>
    #include <dt-bindings/mfd/mt6375.h>
    i2c {
      #address-cells = <1>;
      #size-cells = <0>;

      pmic@34 {
        compatible = "mediatek,mt6375";
        reg = <0x34>;
        interrupts-extended = <&pio 15 IRQ_TYPE_LEVEL_LOW>;
        interrupt-controller;
        #interrupt-cells = <1>;

        mt6375_adc: adc {
          compatible = "mediatek,mt6375-adc";
          #io-channel-cells = <1>;
        };

        charger {
          compatible = "mediatek,mt6375-charger";
          interrupts = <MT6375_FL_PWR_RDY>,
                       <MT6375_FL_DETACH>,
                       <MT6375_FL_BC12_DN>;
          interrupt-names = "attach", "detach", "bc12_done";
        };

        gauge {
          compatible = "mediatek,mt6375-gauge";
          io-channels = <&mt6375_adc MT6375_ADC_VBAT>,
                        <&mt6375_adc MT6375_ADC_IBAT>;
          io-channel-names = "vbat", "ibat";
          monitored-battery = <&battery>;
        };
      };
    };
```

## Documentation/devicetree/bindings/mfd/mediatek,mt6685.yaml
```yaml
# SPDX-License-Identifier: GPL-2.0-only OR BSD-2-Clause
%YAML 1.2
---
$id: http://devicetree.org/schemas/mfd/mediatek,mt6685.yaml#
$schema: http://devicetree.org/meta-schemas/core.yaml#

title: MediaTek MT6685 SPMI PMIC

maintainers:
  - Kara <karagos01@gmail.com>

description:
  The MT6685 is a MediaTek companion PMIC on the System Power Management
  Interface (SPMI) bus, providing the clock-buffer and related functions for
  the connectivity A-die. It is a multi-function device whose sub-functions
  are described in child nodes.

  The MT6685 aggregates its sub-function interrupts (such as the RTC alarm)
  into one SCK_TOP interrupt group that it raises on its SPMI interrupt line.
  When that line is wired up the PMIC acts as an interrupt controller for its
  sub-functions, which reference their interrupt by its number in the group.

properties:
  compatible:
    const: mediatek,mt6685

  reg:
    maxItems: 1

  interrupts:
    maxItems: 1
    description:
      The SPMI interrupt line on which the PMIC raises its aggregated
      SCK_TOP interrupt group.

  interrupt-controller: true

  "#interrupt-cells":
    const: 2
    description:
      The first cell is the sub-function interrupt number within the SCK_TOP
      group, the second cell is the trigger type.

  rtc:
    type: object
    $ref: /schemas/rtc/rtc.yaml#
    unevaluatedProperties: false
    description:
      MT6685 Real Time Clock.

    properties:
      compatible:
        const: mediatek,mt6685-rtc

      interrupts:
        maxItems: 1

    required:
      - compatible

required:
  - compatible
  - reg

dependencies:
  interrupt-controller: ["#interrupt-cells", interrupts]

additionalProperties: false

examples:
  - |
    #include <dt-bindings/interrupt-controller/irq.h>
    #include <dt-bindings/spmi/spmi.h>

    spmi {
        #address-cells = <2>;
        #size-cells = <0>;

        pmic@9 {
            compatible = "mediatek,mt6685";
            reg = <0x9 SPMI_USID>;
            interrupts = <9 0 IRQ_TYPE_LEVEL_HIGH>;
            interrupt-controller;
            #interrupt-cells = <2>;

            rtc {
                compatible = "mediatek,mt6685-rtc";
                interrupts = <0 IRQ_TYPE_LEVEL_HIGH>;
            };
        };
    };
```

## Documentation/devicetree/bindings/net/bluetooth/mediatek,mt6878-bluetooth.yaml
```yaml
# SPDX-License-Identifier: GPL-2.0-only OR BSD-2-Clause
%YAML 1.2
---
$id: http://devicetree.org/schemas/net/bluetooth/mediatek,mt6878-bluetooth.yaml#
$schema: http://devicetree.org/meta-schemas/core.yaml#

title: MediaTek MT6878 connsys Bluetooth

maintainers:
  - Jan Benedikt <karagos01@gmail.com>

description:
  The Bluetooth controller in the MT6878 lives in the "BGF" subsystem of the
  MediaTek connectivity combo ("connsys"), together with WiFi, GPS and FM. The
  connsys power domain, the shared A-die and the analog supplies are brought up
  by the connsys controller (see
  Documentation/devicetree/bindings/soc/mediatek/mediatek,mt6878-connsys.yaml);
  the bootloader stages the BGF firmware into the connsys EMI. This node powers
  the BGF subsystem on top of that and exchanges HCI with the firmware over a
  shared-memory ring in that EMI.

allOf:
  - $ref: bluetooth-controller.yaml#

properties:
  compatible:
    const: mediatek,mt6878-bluetooth

  reg:
    items:
      - description: conn_infra register window
      - description: BGF subsystem ("D-die") register window

  reg-names:
    items:
      - const: conn
      - const: bgf

  interrupts:
    maxItems: 1
    description: BGF software interrupt, raised by the firmware on RX data.

  mediatek,connsys:
    $ref: /schemas/types.yaml#/definitions/phandle
    description:
      Phandle to the connsys combo controller that owns the shared power
      domain, A-die and EMI this Bluetooth subsystem sits on.

required:
  - compatible
  - reg
  - reg-names
  - interrupts
  - mediatek,connsys

unevaluatedProperties: false

examples:
  - |
    #include <dt-bindings/interrupt-controller/arm-gic.h>
    #include <dt-bindings/interrupt-controller/irq.h>

    bluetooth@18800000 {
        compatible = "mediatek,mt6878-bluetooth";
        reg = <0x18000000 0x61000>,
              <0x18800000 0x21000>;
        reg-names = "conn", "bgf";
        interrupts = <GIC_SPI 693 IRQ_TYPE_LEVEL_HIGH 0>;
        mediatek,connsys = <&consys>;
        local-bd-address = [1a a6 ab c6 9e 58];
    };
```

## Documentation/devicetree/bindings/power/supply/mediatek,mt6375-charger.yaml
```yaml
# SPDX-License-Identifier: (GPL-2.0-only OR BSD-2-Clause)
%YAML 1.2
---
$id: http://devicetree.org/schemas/power/supply/mediatek,mt6375-charger.yaml#
$schema: http://devicetree.org/meta-schemas/core.yaml#

title: MediaTek MT6375 Battery Charger

maintainers:
  - Jan Benedikt <karagos01@gmail.com>

description:
  This module is part of the MT6375 MFD device. It provides the single-cell
  switching battery charger with BC1.2 USB port detection.

allOf:
  - $ref: power-supply.yaml#

properties:
  compatible:
    const: mediatek,mt6375-charger

  monitored-battery:
    description:
      The battery the charger feeds. Its constant-charge-current-max-microamp,
      constant-charge-voltage-max-microvolt and charge-term-current-microamp
      set the charge current, the charge voltage and the end-of-charge
      termination current.

  interrupts:
    description:
      The charger uses the power-ready and detach events to track whether an
      input supply is present and the BC1.2-done event to learn the detected
      USB port type.
    items:
      - description: irq of "input power is ready"
      - description: irq of "input detached"
      - description: irq of "BC1.2 detection is done"

  interrupt-names:
    items:
      - const: attach
      - const: detach
      - const: bc12_done

  usb-otg-vbus-regulator:
    type: object
    $ref: /schemas/regulator/regulator.yaml#
    description:
      The VBUS boost regulator that sources 5V on the USB Type-C port in
      OTG/host mode.
    unevaluatedProperties: false

required:
  - compatible
  - interrupts
  - interrupt-names

unevaluatedProperties: false

...
```

## Documentation/devicetree/bindings/power/supply/mediatek,mt6375-gauge.yaml
```yaml
# SPDX-License-Identifier: (GPL-2.0-only OR BSD-2-Clause)
%YAML 1.2
---
$id: http://devicetree.org/schemas/power/supply/mediatek,mt6375-gauge.yaml#
$schema: http://devicetree.org/meta-schemas/core.yaml#

title: MediaTek MT6375 Fuel Gauge

maintainers:
  - Kara <karagos01@gmail.com>

description:
  This module is part of the MT6375 MFD device. It reports the battery
  voltage and current from the on-chip ADC and derives the state of charge
  from the open-circuit-voltage table of the monitored battery.

properties:
  compatible:
    const: mediatek,mt6375-gauge

  io-channels:
    items:
      - description: battery voltage
      - description: battery current

  io-channel-names:
    items:
      - const: vbat
      - const: ibat

  monitored-battery: true

required:
  - compatible
  - io-channels
  - io-channel-names
  - monitored-battery

additionalProperties: false

...
```

## Documentation/devicetree/bindings/regulator/mediatek,mt6369-regulator.yaml
```yaml
# SPDX-License-Identifier: GPL-2.0-only OR BSD-2-Clause
%YAML 1.2
---
$id: http://devicetree.org/schemas/regulator/mediatek,mt6369-regulator.yaml#
$schema: http://devicetree.org/meta-schemas/core.yaml#

title: MediaTek MT6369 PMIC Regulators

maintainers:
  - Jan Benedikt <karagos01@gmail.com>

description:
  The MT6369 is an SPMI companion PMIC. This binding covers the LDO
  regulators that feed the connectivity subsystem (vcn33-1, vcn33-2, vant18)
  and the SD card slot (vmch, vmc); other outputs are not described.

properties:
  compatible:
    const: mediatek,mt6369-regulator

  reg:
    maxItems: 1

  regulators:
    type: object
    additionalProperties: false
    patternProperties:
      "^vcn33-[12]$":
        type: object
        $ref: regulator.yaml#
        unevaluatedProperties: false
      "^(vmch|vmc|vant18)$":
        type: object
        $ref: regulator.yaml#
        unevaluatedProperties: false

required:
  - compatible
  - reg
  - regulators

additionalProperties: false

examples:
  - |
    #include <dt-bindings/spmi/spmi.h>

    spmi {
        #address-cells = <2>;
        #size-cells = <0>;

        pmic@5 {
            compatible = "mediatek,mt6369-regulator";
            reg = <0x5 SPMI_USID>;

            regulators {
                vcn33-1 {
                    regulator-name = "mt6369_vcn33_1";
                    regulator-min-microvolt = <3300000>;
                    regulator-max-microvolt = <3500000>;
                };

                vmch {
                    regulator-name = "mt6369_vmch";
                    regulator-min-microvolt = <2900000>;
                    regulator-max-microvolt = <2900000>;
                };
            };
        };
    };
```
